## firmware/esp32c3/app/main/Kconfig.projbuild
```kconfig
menu "WiFi cartridge"
    choice GBW_BOARD
        prompt "Board"
        default GBW_BOARD_CART
        config GBW_BOARD_CART
            bool "Cartridge Rev B (U104)"
        config GBW_BOARD_XIAO
            bool "Seeed XIAO ESP32C3 bench test (no ADC dividers: fixed full reservoir, USB power)"
            help
                Same SPI pins as the cart (D0 = IO2 MISO, D4 = IO6 SCK, D5 = IO7 MOSI, D10 = IO10 CS), so an RP2350
                (Pico 2 link tester) can be wired straight to it. IO0/IO1 are not on the XIAO's pins, so the power
                manager gets fixed readings. Never flash this onto a cart: it would ignore the real reservoir.
    endchoice
endmenu
```

## firmware/xiao/rf_logger/main/Kconfig.projbuild
```kconfig
menu "RF logger"
    config RFLOG_WIFI_SSID
        string "WiFi SSID"
        default ""
    config RFLOG_WIFI_PASSWORD
        string "WiFi password"
        default ""
    config RFLOG_HOST
        string "IP address of the computer running rf_host.py"
        default "192.168.1.10"
    config RFLOG_PORT
        int "TCP port of rf_host.py"
        default 5201
    config RFLOG_TPUT_SECONDS
        int "Seconds per throughput run"
        default 5
endmenu
```

## firmware/xiao/rf_logger/sdkconfig.defaults
```kconfig
CONFIG_IDF_TARGET="esp32c3"
CONFIG_ESP_CONSOLE_USB_SERIAL_JTAG=y
CONFIG_ESP_DEFAULT_CPU_FREQ_MHZ_160=y
CONFIG_ESP_PHY_CALIBRATION_AND_DATA_STORAGE=y
CONFIG_ESP_PHY_RF_CAL_PARTIAL=y
```
